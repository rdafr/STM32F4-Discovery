#include "stm32f4xx.h"                  // Device header

//LEDS ON STM32F4-DISCOVERY
#define   LED_RED      GPIO_ODR_OD14_Pos
#define   LED_GREEN    GPIO_ODR_OD12_Pos

//DEFINE USER BUTTON
#define   BUTTON_1     GPIO_IDR_ID0_Pos

//DEFINE SECOND INTERRUPTION
#define   INTR_2			 GPIO_IDR_ID1_Pos

int main()
{
	__disable_irq();
	
	//ENABLE IO PORTD AND PORTA CLOCK IN RCC REGISTER
	RCC->AHB1ENR |= (1 << RCC_AHB1ENR_GPIODEN_Pos)| 
									(1 << RCC_AHB1ENR_GPIOAEN_Pos)|
									(1 << RCC_AHB1ENR_GPIOCEN_Pos);
	
	//ENABLE SYSCFG CLOCK
	RCC->APB2ENR |= RCC_APB2ENR_SYSCFGEN;
	
	//CONFIGURING BUTTON PIN AND SECOND INTERRUPTION AS INPUT
	GPIOA->MODER &= ~(1 << GPIO_MODER_MODER0_Pos);	
	GPIOC->MODER &= ~(1 << GPIO_MODER_MODER1_Pos);
	
	//CONFIGURING LED PINS AS OUTPUT
	GPIOD->MODER |= GPIO_MODER_MODER14_0 |
									GPIO_MODER_MODER12_0;
	
  //CONFIGURING BUTTON PORT WITHOUT PULL-UP/DOWN
	GPIOA->PUPDR &= ~(1 << GPIO_PUPDR_PUPD0_Pos);
	
	//CONFIGURING SECOND INTERRUPTION WITH PULL-UP
	GPIOC->PUPDR |= (1 << GPIO_PUPDR_PUPD1_Pos);
	
	//CONFIGURING LED PORT WITH PULL-UP
	GPIOD->PUPDR |= GPIO_PUPDR_PUPD14_0 |
									GPIO_PUPDR_PUPD12_0;
	
	//PA0 AS EXTI0 AND PC1 AS EXTI1 IN FALLING EDGE 
	SYSCFG->EXTICR[0] |= SYSCFG_EXTICR1_EXTI0_PA | SYSCFG_EXTICR1_EXTI1_PC;
	EXTI->IMR |= 1 | (1 << 1);
	EXTI->FTSR |= 1 | (1 << 1);
	
	__NVIC_EnableIRQ(EXTI0_IRQn);
	__NVIC_EnableIRQ(EXTI1_IRQn);
  __enable_irq();
		
	while(1);
}	

void EXTI0_IRQHandler()
{
	if (EXTI->PR & (1 << BUTTON_1)) 
	{
		GPIOD->ODR ^= (1 << LED_RED);
		EXTI->PR |= 1 << EXTI_PR_PR0_Pos;
	}
}	

void EXTI1_IRQHandler()
{
	if (EXTI->PR & (1 << INTR_2)) 
	{
		GPIOD->ODR ^= (1 << LED_GREEN);
		EXTI->PR |= 1 << EXTI_PR_PR1_Pos;
	}
}	
