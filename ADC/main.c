#include "stm32f4xx.h"                  // Device header

//LEDS ON STM32F4-DISCOVERY
#define   LED_RED      GPIO_ODR_OD14_Pos
#define   LED_GREEN    GPIO_ODR_OD12_Pos
#define   LED_BLUE     GPIO_ODR_OD15_Pos
#define   LED_ORANGE   GPIO_ODR_OD13_Pos

uint16_t value;

int main()
{
	//ENABLE IO PORTD AND IO PORTC CLOCK 
	RCC->AHB1ENR |= (1 << RCC_AHB1ENR_GPIODEN_Pos)|
									(1 << RCC_AHB1ENR_GPIOCEN_Pos);
	
	//ENABLE ADC CLOCK
	RCC->APB2ENR |= RCC_APB2ENR_ADC1EN_Msk;
	
	//CONFIGURING LED PINS AS OUTPUT
	GPIOD->MODER |= GPIO_MODER_MODER12_0 | GPIO_MODER_MODER13_0 |
									GPIO_MODER_MODER14_0 | GPIO_MODER_MODER15_0;
	
	//CONFIGURING PC1 AS AN ANALOG PIN
	GPIOC-> MODER |= (3 << GPIO_MODER_MODER1_Pos);
	
	//CONFIGURING PORT PULL-UP
	GPIOD->PUPDR |= GPIO_PUPDR_PUPD12_0 | GPIO_PUPDR_PUPD13_0 |
									GPIO_PUPDR_PUPD14_0 | GPIO_PUPDR_PUPD15_0;

	//TURN ON ADC AND ACTIVATE 1TH CONV. IN CH11
	ADC1->SQR3 |= 0x0B;
	ADC1->CR2 |= ADC_CR2_ADON_Msk;
	
	//CONFIGURING ADC RESOLUTION
	ADC1->CR1 |= ADC_CR1_RES_1;
	
	while(1)
	{	
		//START CONVERSION
		ADC1->CR2 |= ADC_CR2_SWSTART_Msk;
		
		while(!(ADC1->SR & ADC_SR_EOC_Msk));
		value = ADC1->DR;
		//TOGGLE LEDS
		if(value > 100) GPIOD->ODR |= (1 << LED_RED)|(1 << LED_BLUE)|(1 << LED_GREEN)|(1 << LED_ORANGE);
		else GPIOD->ODR = 0;
	}
}	

